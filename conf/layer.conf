## conf/layer.conf
```bitbake
# We have a conf and classes directory, append to BBPATH
BBPATH .= ":${LAYERDIR}"

# We have a recipes directory, add to BBFILES
BBFILES += "${LAYERDIR}/recipes*/*/*.bb ${LAYERDIR}/recipes*/*/*.bbappend"

BBFILE_COLLECTIONS += "pkemb-layer"
BBFILE_PATTERN_pkemb-layer := "^${LAYERDIR}/"
BBFILE_PRIORITY_pkemb-layer = "30"
LAYERSERIES_COMPAT_pkemb-layer = "mickledore"
LAYERDEPENDS_pkemb-layer = "core"

BBFILES_DYNAMIC += " \
    openembedded-layer:${LAYERDIR}/dynamic-layers/openembedded-layer/*/*/*.bb \
    openembedded-layer:${LAYERDIR}/dynamic-layers/openembedded-layer/*/*/*.bbappend \
"
```
